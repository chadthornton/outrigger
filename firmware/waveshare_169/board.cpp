// The board drivers. Which chips and pins come from a BoardConfig at run time
// (board_config_types.h): a profile stored on the board (set over Computer
// mode, profile_link.h), else the build's own kBoardConfig (board_config.h,
// generated by tools/boards.py from firmware/boards.json). Every driver is in
// every build, so a new board is a new profile; code goes here only for a
// display, touch or expander chip not driven yet.
//
// Displays: ILI9341, ST7789 and ST7796 over SPI (Arduino_GFX). Touch: CST816 and FT6336,
// which share one register layout (status at 0x02, the first point at 0x03-0x06).
// Expander: TCA9554 on the touch chip's I2C bus, for boards that put the panel's
// reset or a held pin on it.

#include <Arduino.h>
#include <Arduino_GFX_Library.h>
#include <Preferences.h>
#include <Wire.h>
#include <esp_attr.h>
#include <esp_system.h>

#include "board_blob.h"
#include "board_config.h"
#include "board_profile.h"
#include "board_store.h"
#include "touch_map.h"

// The build's own board: what runs when no good profile is stored.
extern const BoardProfile kBoard = BOARD_PROFILE_INIT;

// The board being driven: board_select() picks it, before board_display_begin.
static BoardConfig active = kBoardConfig;
static BoardProfile active_profile = kBoard;
static BoardBlob stored;  // the stored profile, when it's the one in use (its name lives here)
static const BoardConfig &cfg = active;
static const char *source = "built in";

// ---------- The stored profile (NVS: its own namespace, so a settings reset keeps it) ----------
static const char *kNamespace = "boardprof", *kKey = "blob";

size_t board_store_load(uint8_t *out, size_t max) {
  Preferences p;
  if (!p.begin(kNamespace, true)) return 0;
  const size_t n = p.getBytesLength(kKey);
  const size_t got = n && n <= max ? p.getBytes(kKey, out, n) : 0;
  p.end();
  return got;
}

bool board_store_save(const uint8_t *data, size_t len) {
  Preferences p;
  if (!p.begin(kNamespace, false)) return false;
  const bool ok = p.putBytes(kKey, data, len) == len;
  p.end();
  return ok;
}

void board_store_forget() {
  Preferences p;
  if (p.begin(kNamespace, false)) {
    p.remove(kKey);
    p.end();
  }
}

// Crash restarts (panic, watchdog, brownout) before kSettledMs, in a row:
// survives the restart, not a power cut. The board's own restarts (Computer
// mode, Back to MIDI, a firmware switch's) reset the count. Three in a row
// with a stored profile and it's set aside.
constexpr uint32_t kEarlyMagic = 0x4F425031;  // "OBP1"
constexpr uint32_t kSettledMs = 15000;
static RTC_NOINIT_ATTR uint32_t early_magic, early_boots;

#if CONFIG_SPIRAM_MODE_QUAD
constexpr bool kQuadPsram = true;
#else
constexpr bool kQuadPsram = false;
#endif

bool board_build_quad_psram() { return kQuadPsram; }

const char *board_select() {
  const esp_reset_reason_t why = esp_reset_reason();
  const bool crash = why == ESP_RST_PANIC || why == ESP_RST_INT_WDT || why == ESP_RST_TASK_WDT ||
                     why == ESP_RST_WDT || why == ESP_RST_BROWNOUT;
  if (early_magic != kEarlyMagic || !crash) {
    early_magic = kEarlyMagic;
    early_boots = 0;
  }
  if (crash) ++early_boots;
  uint8_t bytes[kBlobSize];
  const size_t n = board_store_load(bytes, sizeof bytes);
  if (!n) return source;
  if (early_boots >= 3) return source = "built in (the stored profile crashed 3 starts in a row)";
  BoardBlob b;
  if (board_blob_decode(bytes, n, b) != BlobError::Ok || board_blob_check(b, nullptr, 0) != BlobError::Ok ||
      b.quad_psram != kQuadPsram)
    return source = "built in (the stored profile isn't usable)";
  stored = b;
  active = stored.config;
  active_profile = stored.profile();
  return source = "stored";
}

const BoardProfile &board_profile() { return active_profile; }
const char *board_source() { return source; }

// BOOT held for 3 s during the first kSettledMs forgets the stored profile,
// then on_escape runs (the app's Computer mode). Its own task, started before
// the screen: a profile that hangs board_display_begin or ui_begin can still be
// escaped. Held at power-on BOOT means ROM download mode instead, so it's
// watched after the start. At kSettledMs the start counts as settled, ending
// the early-boot count, and the task ends.
static void (*escape_to)() = nullptr;

static void escape_task(void *) {
  pinMode(0, INPUT_PULLUP);
  uint32_t down_since = 0;
  while (millis() < kSettledMs) {
    if (digitalRead(0) != LOW) {
      down_since = 0;
    } else if (!down_since) {
      down_since = millis() ? millis() : 1;
    } else if (millis() - down_since >= 3000) {
      board_store_forget();
      if (escape_to) escape_to();  // restarts, unless a job is running
      vTaskDelete(nullptr);
    }
    vTaskDelay(pdMS_TO_TICKS(50));
  }
  early_boots = 0;
  vTaskDelete(nullptr);
}

void board_watch_escape(void (*on_escape)()) {
  escape_to = on_escape;
  xTaskCreatePinnedToCore(escape_task, "board_escape", 3072, nullptr, 1, nullptr, 0);
}

// A profile's pin: GPIO n is n, expander pin n is 100 + n, none is -1.
constexpr int16_t kExio = 100;
static int8_t gpio_or_none(int16_t pin) { return pin >= 0 && pin < kExio ? pin : GFX_NOT_DEFINED; }
// The panel unturned: Arduino_GFX takes these and turns the picture itself.
static int16_t native_w() { return cfg.rotation & 1 ? kBoard.height : kBoard.width; }
static int16_t native_h() { return cfg.rotation & 1 ? kBoard.width : kBoard.height; }

// The SPI bus, in the profile's mode when it names one. Arduino_GFX's panel
// classes pick a mode themselves (ST7789 and ST7796: 3, ILI9341: 0), and the
// 3.5"'s ST7796 needs 0: with CS tied low it can't resync (boards.json).
class ProfileSPI : public Arduino_ESP32SPI {
 public:
  ProfileSPI(int8_t dc, int8_t cs, int8_t sck, int8_t mosi, int8_t miso, int8_t mode)
      : Arduino_ESP32SPI(dc, cs, sck, mosi, miso), mode_(mode) {}
  bool begin(int32_t speed, int8_t data_mode) override {
    return Arduino_ESP32SPI::begin(speed, mode_ >= 0 ? mode_ : data_mode);
  }

 private:
  int8_t mode_;
};

static Arduino_DataBus *bus;
static Arduino_TFT *panel;

static Arduino_TFT *make_panel() {
  const int8_t rst = gpio_or_none(cfg.lcd_rst);
  const int16_t *o = cfg.offsets;
  switch (cfg.panel) {
    case PanelDriver::ST7796:
      return new Arduino_ST7796(bus, rst, cfg.rotation, cfg.ips, native_w(), native_h(), o[0], o[1], o[2], o[3]);
    case PanelDriver::ILI9341:
      return new Arduino_ILI9341(bus, rst, cfg.rotation, cfg.ips, native_w(), native_h(), o[0], o[1], o[2], o[3]);
    case PanelDriver::ST7789:
    default:
      return new Arduino_ST7789(bus, rst, cfg.rotation, cfg.ips, native_w(), native_h(), o[0], o[1], o[2], o[3]);
  }
}

// TCA9554 registers: 0x01 the outputs, 0x03 the directions (1 = input). It
// powers up all inputs, pulled high.
static uint8_t exio_out = 0xFF, exio_dir = 0xFF;
static void exio_set(uint8_t reg, uint8_t value) {
  Wire.beginTransmission(cfg.expander_address);
  Wire.write(reg);
  Wire.write(value);
  Wire.endTransmission();
}

static void pin_write(int16_t pin, bool high) {
  if (pin < 0) return;
  if (pin >= kExio) {
    if (cfg.expander != ExpanderDriver::TCA9554) return;  // boards.py refuses expander pins without one
    const uint8_t bit = 1 << (pin - kExio);
    exio_out = high ? exio_out | bit : exio_out & ~bit;
    exio_dir &= ~bit;
    exio_set(0x01, exio_out);  // the level first, so the pin never drives the old one
    exio_set(0x03, exio_dir);
    return;
  }
  pinMode(pin, OUTPUT);
  digitalWrite(pin, high ? HIGH : LOW);
}

#if APP_SYNTH
// The synth turns the speaker amplifier, a hold_low pin, on and off (lib/synth/src/audio_out.cpp).
void board_pin_write(int16_t pin, bool high) { pin_write(pin, high); }
#endif

void board_update_pins(int8_t high[4], int8_t low[4]) {
  int nh = 0, nl = 0;
  for (int i = 0; i < 4; ++i) high[i] = low[i] = -1;
  auto add = [](int8_t *to, int &n, int16_t pin) {
    if (pin >= 0 && pin < kExio && n < 4) to[n++] = int8_t(pin);
  };
  add(high, nh, cfg.lcd_bl);
  for (int16_t pin : cfg.hold_high) add(high, nh, pin);
  for (int16_t pin : cfg.hold_low) add(low, nl, pin);
}

bool board_display_begin() {
  const bool expander = cfg.expander != ExpanderDriver::None;
  if (expander) Wire.begin(cfg.tp_sda, cfg.tp_scl, 400000);
  // Pins wired to something Outrigger doesn't use (a buzzer, a speaker
  // amplifier) that would make noise left floating or on (boards.json, hold_why).
  for (int16_t pin : cfg.hold_low) pin_write(pin, false);
  for (int16_t pin : cfg.hold_high) pin_write(pin, true);
  if (cfg.lcd_rst >= kExio) {  // Arduino_GFX resets the panel itself only from a GPIO
    pin_write(cfg.lcd_rst, true);
    delay(10);
    pin_write(cfg.lcd_rst, false);
    delay(10);
    pin_write(cfg.lcd_rst, true);
    delay(200);
  }
  bus = new ProfileSPI(gpio_or_none(cfg.lcd_dc), gpio_or_none(cfg.lcd_cs), gpio_or_none(cfg.lcd_sck),
                       gpio_or_none(cfg.lcd_mosi), gpio_or_none(cfg.lcd_miso), cfg.spi_mode);
  panel = make_panel();
  if (!panel->begin(cfg.spi_hz)) return false;
  // Some panels miss their first start after a cold power-on; their makers'
  // firmware restarts once, after the bus is up (boards.json, restart_why).
  if (cfg.restart_on_power_on && esp_reset_reason() == ESP_RST_POWERON) esp_restart();
  // The profile's colour order and mirrors, over Arduino_GFX's own MADCTL byte.
  if (panel_overrides(cfg.bgr, cfg.mirror_x, cfg.mirror_y)) {
    bus->beginWrite();
    bus->writeC8D8(0x36, panel_madctl(cfg.panel, cfg.rotation, cfg.bgr, cfg.mirror_x, cfg.mirror_y));
    bus->endWrite();
  }
  panel->fillScreen(0);
  pin_write(cfg.lcd_bl, true);

  if (cfg.tp_rst >= 0) {
    pin_write(cfg.tp_rst, false);
    delay(10);
    pin_write(cfg.tp_rst, true);
    // After its reset the touch chip ignores I2C for a while: FocalTech asks
    // for 300 ms; the CST816 answers after 50.
    delay(cfg.touch == TouchDriver::FT6336 ? 300 : 50);
  }
  if (!expander) Wire.begin(cfg.tp_sda, cfg.tp_scl, 400000);
  if (cfg.touch == TouchDriver::CST816) {
    // Keep the touch chip awake; asleep it ignores I2C until touched.
    Wire.beginTransmission(cfg.touch_address);
    Wire.write(0xFE);
    Wire.write(0x01);
    Wire.endTransmission();
  }
  return true;
}

void board_display_flush(int16_t x, int16_t y, int16_t w, int16_t h, const uint16_t *pixels) {
  panel->draw16bitRGBBitmap(x, y, const_cast<uint16_t *>(pixels), w, h);
}

#if UI_TOUCH_PROBE
int16_t board_touch_raw[2] = {-1, -1};
#endif

bool board_touch_read(int16_t *x, int16_t *y) {
  uint8_t buf[7];
  Wire.beginTransmission(cfg.touch_address);
  Wire.write(0x00);
  if (Wire.endTransmission(false) != 0) return false;
  if (Wire.requestFrom(cfg.touch_address, (uint8_t)sizeof buf) != sizeof buf) return false;
  for (uint8_t &b : buf) b = Wire.read();
  const uint8_t fingers = buf[2] & 0x0F;
  if (buf[2] == 0xFF || fingers == 0) return false;
  const int16_t rx = ((buf[3] & 0x0F) << 8) | buf[4], ry = ((buf[5] & 0x0F) << 8) | buf[6];
#if UI_TOUCH_PROBE
  board_touch_raw[0] = rx;
  board_touch_raw[1] = ry;
#endif
  touch_map::to_screen(rx, ry, cfg.rotation, native_w(), native_h(), x, y, cfg.touch_swap_xy, cfg.touch_invert_x,
                       cfg.touch_invert_y);
  return true;
}
